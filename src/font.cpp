/*========================================================================
 *  Copyright (c) 2017 Martin7182
 *
 *  This file is part of GSOSD.
 *
 *  GSOSD is free software: you can redistribute it and/or modify
 *  it under the terms of the GNU General Public License as published by
 *  the Free Software Foundation, either version 3 of the License, or
 *  (at your option) any later version.
 *
 *  GSOSD is distributed in the hope that it will be useful,
 *  but WITHOUT ANY WARRANTY; without even the implied warranty of
 *  MERCHANTABILITY or FITNESS FOR A PARTICULAR PURPOSE.  See the
 *  GNU General Public License for more details.
 *
 *  You should have received a copy of the GNU General Public License
 *  along with GSOSD.  If not, see <http://www.gnu.org/licenses/>.
 *
 *  File	: font.cpp
 *  Purpose	: Font handling.
 *  Author(s)	: Martin7182
 *  Creation	: 2017/10/16
 *
 *========================================================================
 */

#include <Arduino.h>
#include <stdio.h>
#include <stdlib.h>
#include <stdbool.h>
#include <stdarg.h>
#include "max7456.h"
#include "font.h"

//Workaround for http://gcc.gnu.org/bugzilla/show_bug.cgi?id=34734
#ifdef PROGMEM
#undef PROGMEM
#define PROGMEM __attribute__((section(".progmem.data")))
#endif

/*
 * Default font that is loaded when resetting the font.
 * The Max7456's font memory stores 256 characters, 18 * 12 pixels per
 * character that can be white, black or transparent. So 2 bits per pixel and
 * a total of 54 bytes per character. Storing this plain would take too much
 * space. Therefore we store the white pixels only and apply a simple algorithm
 * to calculate the black pixels. The remaining pixels will be transparent.
 * Note that bytes of below pixel map are MSB-first based. So e.g. for byte
 * 0x01 the first pixel is set rather than the last.
 *
 * Below data is generated with fonts/gif2osd.php.
 */
const uint8_t DEFAULTFONT[256][(18 * 12 / 8)] PROGMEM = {
    { 0x00,0x00,0x00,0x00,0x00,0x00,0x00,0x00,0x00,0x00,0x00,0x00,0x00,0x00,
      0x00,0x00,0x00,0x00,0x00,0x00,0x00,0x00,0x00,0x00,0x00,0x00,0x00 },
    { 0x00,0x10,0x01,0x00,0x10,0x01,0x00,0x10,0x01,0x00,0x10,0x01,0x00,0x10,
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      0xD8,0x0D,0x80,0xD8,0x07,0x00,0x70,0x03,0x00,0x60,0x3E,0x03,0xC0 },
};


/*------------------------------------------------------------------------
 *  Function	: is_pixel_bits
 *  Purpose	: Determine if fontbuf has given bits set at given coordinates.
 *  Method	: For each of the two pixel bits: locate byte in 12 pixel wide
 *  		  image, locate bit in byte and compare.
 *
 *  Returns	: True if fontbuf[x,y] has bits set as given, false otherwise.
 *------------------------------------------------------------------------
 */
static bool
is_pixel_bits(
	fontbuf_t 	*fontbuf,	/* font character buffer */
	uint8_t		x,		/* x-coordinate of pixel to check */
	uint8_t		y,		/* y-coordinate of pixel to check */
	bool		firstbitset,	/* first pixel bit value to check */
	bool		secondbitset)	/* second pixel bit value to check */
{
    uint16_t	pixpos;			/* pixel position in fontbuf */
    uint8_t 	byteidx1;		/* index of first byte to check */
    uint8_t 	bitidx1;		/* index of bit in first byte */
    uint8_t 	byteidx2;		/* index of second byte to check */
    uint8_t 	bitidx2;		/* index of bit in second byte */

    pixpos = 2 * y * 12 + 2 * x;
    byteidx1 = pixpos / 8;
    bitidx1  = pixpos % 8;
    byteidx2 = (pixpos + 1) / 8;
    bitidx2  = (pixpos + 1) % 8;
    if (byteidx1 >= sizeof(*fontbuf)
	|| byteidx2 >= sizeof(*fontbuf)) return false;
    return (((((*fontbuf)[byteidx1]
	        & (0x01 << (7 - bitidx1))) != 0x00) == firstbitset)
        && ((((*fontbuf)[byteidx2]
		& (0x01 << (7 - bitidx2))) != 0x00) == secondbitset));
} /* is_pixel_bits() */


/*------------------------------------------------------------------------
 *  Function	: is_whitepixel
 *  Purpose	: Determine if fontbuf has a white pixel at given coordinates.
 *  Method	: Use generic function to check the two bits.
 *
 *  Returns	: True if fontbuf[x,y] has white pixel, false otherwise.
 *------------------------------------------------------------------------
 */
static bool
is_whitepixel(
	fontbuf_t 	*fontbuf,	/* font character buffer */
	uint8_t		x,		/* x-coordinate of pixel to check */
	uint8_t		y)		/* y-coordinate of pixel to check */
{
    return is_pixel_bits(fontbuf, x, y, true, false);
} /* is_whitepixel() */


/*------------------------------------------------------------------------
 *  Function	: is_blackpixel
 *  Purpose	: Determine if fontbuf has a black pixel at given coordinates.
 *  Method	: Use generic function to check the two bits.
 *
 *  Returns	: True if fontbuf[x,y] has black pixel, false otherwise.
 *------------------------------------------------------------------------
 */
static bool
is_blackpixel(
	fontbuf_t 	*fontbuf,	/* font character buffer */
	uint8_t		x,		/* x-coordinate of pixel to check */
	uint8_t		y)		/* y-coordinate of pixel to check */
{
    return is_pixel_bits(fontbuf, x, y, false, false);
} /* is_blackpixel() */


/*------------------------------------------------------------------------
 *  Function	: is_transpixel
 *  Purpose	: Determine if fontbuf has a transparent pixel at given
 *  		  coordinates.
 *  Method	: Use generic function to check the two bits.
 *
 *  Returns	: True if fontbuf[x,y] has transparent pixel, false otherwise.
 *------------------------------------------------------------------------
 */
#ifdef FUTURE_EXT
static bool
is_transpixel(
	fontbuf_t 	*fontbuf,	/* font character buffer */
	uint8_t		x,		/* x-coordinate of pixel to check */
	uint8_t		y)		/* y-coordinate of pixel to check */
{
    return is_pixel_bits(fontbuf, x, y, false, true)
        || is_pixel_bits(fontbuf, x, y, true, true);
} /* is_transpixel() */
#endif


/*------------------------------------------------------------------------
 *  Function	: font_apply
 *  Purpose	: Reset the font to inbuilt hard-coded values or apply effect
 *  		  to current font.
 *  Method	: Get font character from progmem or from Max7456 chip,
 *  		  modify, write to Max7456 chip.
 *
 *  Note that font effects do stack on top of each other. For example, if you
 *  apply FE_TRANSWHTE + FE_INVERT then you will get completely black
 *  characters. Then you can even e.g. clear the font by adding another
 *  FE_TRANSWHITE effect.
 *
 *  Returns	: Indication of success.
 *------------------------------------------------------------------------
 */
bool
font_apply(
    fonteffect_p	fonteffect)	/* effect to apply or NULL to reset */
{
    int			num;	/* number of character to set [0 .. 255] */
    fonteffect_t	effect;	/* (default) font effect to apply */

    for (num = 0; num <= 255; num++) {
	fontbuf_t 	buf;	/* font character buffer */
	uint8_t 	fbi;	/* byte index in font buffer */
	uint8_t 	byte;	/* output byte for 4 pixels */
	uint8_t 	bi;	/* bit index in output byte */

	/*
	 * The NVM contains 256 rows of 64 bytes i.e. 512 bits per character;
	 * 432 data bits followed by 80 unused bits. The order of pixels is
	 * from top to bottom and from left to right. See the manual for more
	 * info.
	 */
	if (fonteffect == NULL) {
	    /*
	     * Reset font.
	     * Build a pixel map consisting of white pixels only. Note that the
	     * characters of harcoded DEFAULTFONT take half the space of
	     * fontbuf_t. Bytes in the resulting map are like the NVM from top
	     * to bottom and from left to right. Each byte is MSB-first so e.g.
	     * 0x01 tells that the first pixel is white, followed by 3 yet to
	     * determine black or tranparent pixels.
	     */
	    for (uint8_t i = 0; i < sizeof(buf) / 2; i++) {
		byte = pgm_read_byte(&(DEFAULTFONT[num][i]));
		buf[2 * i] = 0x00;
		buf[2 * i + 1] = 0x00;
	        for (bi = 0; bi < 8; bi++) {
                    if (((byte & (0x01 << (7 - bi))) != 0x00)) {
			if (bi < 4) {
		            buf[2 * i] |= (0x01 << (7 - (2 * bi)));
			} else {
		            buf[2 * i + 1] |= (0x01 << (7 - (2 * (bi - 4))));
			}
		    }
		}
	    }
	    effect = FE_BORDER;
	} else {
	    /* Font effect. Get pixel map from Max7456 eeprom. */
	    max_fontcharget((uint8_t)num, &buf);
	    effect = *fonteffect;
	}
	if (num == 0) effect = FE_NONE;	/* Keep empty cells transparent. */

	/* Intinialise counters and output byte. */
	fbi = 0;
	bi = 0;
	byte = 0x00;

        /* Walk 18 vertical character pixels. */
	for (uint8_t y = 0; y < 18; y++) {

            /* Walk 12 horizontal character pixels. */
	    for (uint8_t x = 0; x < 12; x++) {
		/*
		 * Set next two output bits for this pixel:
		 * "00" : black opaque
		 * "10" : white opaque
		 * "*1" : transparent (default)
		 */
		if (is_whitepixel(&buf, x, y)) {
		    /* Set white bit or keep it zero (black) upon invert. */
		    if (effect != FE_INVERT) {
		        byte |= (0x01 << (7 - bi));
		    }
		} else {
		    /*
		     * Possibly set transparent bit (if not black) or set white
		     * bit upon invert.
		     */
		    switch (effect) {
		    case FE_BORDER:
			if (!((x > 0 && is_whitepixel(&buf, x - 1, y))
			    || (x < 11 && is_whitepixel(&buf, x + 1, y))
			    || (y > 0 && is_whitepixel(&buf, x, y - 1))
			    || (y < 17 && is_whitepixel(&buf, x, y + 1)))) {
			    byte |= (0x01 << (6 - bi));
			}
			break;
		    case FE_SHADOW:
			if (!((x > 0 && is_whitepixel(&buf, x - 1, y))
			    || (y > 0 && is_whitepixel(&buf, x, y - 1)))) {
			    byte |= (0x01 << (6 - bi));
			}
			break;
		    case FE_NONE:
			/* fallthrough */
		    case FE_TRANSWHITE:
			byte |= (0x01 << (6 - bi));
			break;
		    case FE_BLACKWHITE:
			    /* Keep pixel black. */
			break;
		    case FE_INVERT:
			if (is_blackpixel(&buf, x, y)) {
			    /* Set white bit. */
			    byte |= (0x01 << (7 - bi));
			} else {
			    /* Set transparent bit. */
			    byte |= (0x01 << (6 - bi));
			}
			break;
		    default:
			break;
		    }
		}
		bi += 2;
		if (bi == 8) {
		    if (fbi < sizeof(buf)) buf[fbi++] = byte;
		    byte = 0x00;
		    bi = 0;
		}
	    }
	}
	max_fontcharput((uint8_t)num, &buf);
    }
    return true;
} /* font_apply() */
